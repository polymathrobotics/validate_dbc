VERSION ""

NS_ :

BS_:

BU_:

BO_ 600 Range_Message: 8 Vector__XXX
 SG_ Wide_Range : 0|1@1+ (1,0) [0|5] "" Vector__XXX
