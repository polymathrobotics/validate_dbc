VERSION ""

NS_ :

BS_:

BU_:

BO_ 400 Dup_Signal_Message: 8 Vector__XXX
 SG_ Same_Name : 0|8@1+ (1,0) [0|255] "" Vector__XXX
 SG_ Same_Name : 8|8@1+ (1,0) [0|255] "" Vector__XXX
